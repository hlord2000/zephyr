## boards/waveshare/rp2350_touch_lcd_2_8/Kconfig.defconfig
```kconfig
# Copyright (c) 2025 Your Name
# SPDX-License-Identifier: Apache-2.0

if BOARD_RP2350_TOUCH_LCD_2_8

config USB_SELF_POWERED
	default n

if DISPLAY

choice ST7789V_PIXEL_FORMAT
	default ST7789V_RGB565
endchoice

if LVGL

config LV_Z_BITS_PER_PIXEL
	default 16

choice LV_COLOR_DEPTH
	default LV_COLOR_DEPTH_16
endchoice

config LV_COLOR_16_SWAP
	default y

endif # LVGL

endif # DISPLAY

endif # BOARD_RP2350_TOUCH_LCD_2_8
```

## boards/waveshare/rp2350_touch_lcd_2_8/Kconfig.rp2350_touch_lcd_2_8
```kconfig
# Copyright (c) 2025 Your Name
# SPDX-License-Identifier: Apache-2.0

config BOARD_RP2350_TOUCH_LCD_2_8
	select SOC_RP2350A_M33
```

## boards/waveshare/rp2350_touch_lcd_2_8/board.yml
```yaml
board:
  name: rp2350_touch_lcd_2_8
  full_name: Waveshare RP2350 Touch LCD 2.8
  vendor: waveshare
  socs:
    - name: rp2350a
```

## drivers/sensor/sensirion/sen6x/Kconfig
```kconfig
# SHT6x air quality sensor configuration options

# Copyright (c) 2025 Kelly Lord
# SPDX-License-Identifier: Apache-2.0

config SEN6X
	bool "SEN6x Air Quality Sensor"
	default y
	depends on DT_HAS_SENSIRION_SEN60_ENABLED     \
		   || DT_HAS_SENSIRION_SEN63C_ENABLED \
		   || DT_HAS_SENSIRION_SEN65_ENABLED  \
		   || DT_HAS_SENSIRION_SEN66_ENABLED  \
		   || DT_HAS_SENSIRION_SEN68_ENABLED
	select I2C
	select CRC
	help
	  Enable driver for SEN6x air quality sensors.
```

## dts/bindings/sensor/sensirion,sen60.yaml
```yaml
#
# Copyright (c) 2025, Kelly Helmut Lord
#
# SPDX-License-Identifier: Apache-2.0

description: Sensirion SEN60 indoor air quality sensor

compatible: "sensirion,sen60"

include: [sensor-device.yaml, i2c-device.yaml]
```

## dts/bindings/sensor/sensirion,sen63c.yaml
```yaml
#
# Copyright (c) 2025, Kelly Helmut Lord
#
# SPDX-License-Identifier: Apache-2.0

description: Sensirion SEN63C indoor air quality sensor

compatible: "sensirion,sen63c"

include: [sensor-device.yaml, i2c-device.yaml]
```

## dts/bindings/sensor/sensirion,sen65.yaml
```yaml
#
# Copyright (c) 2025, Kelly Helmut Lord
#
# SPDX-License-Identifier: Apache-2.0

description: Sensirion SEN65 indoor air quality sensor

compatible: "sensirion,sen65"

include: [sensor-device.yaml, i2c-device.yaml]
```

## dts/bindings/sensor/sensirion,sen66.yaml
```yaml
#
# Copyright (c) 2025, Kelly Helmut Lord
#
# SPDX-License-Identifier: Apache-2.0

description: Sensirion SEN66 indoor air quality sensor

compatible: "sensirion,sen66"

include: [sensor-device.yaml, i2c-device.yaml]
```

## dts/bindings/sensor/sensirion,sen68.yaml
```yaml
#
# Copyright (c) 2025, Kelly Helmut Lord
#
# SPDX-License-Identifier: Apache-2.0

description: Sensirion SEN68 indoor air quality sensor

compatible: "sensirion,sen68"

include: [sensor-device.yaml, i2c-device.yaml]
```
