## boards/helmutlord/knob_array/Kconfig.defconfig
```kconfig
# STM32F072B-DISCO board configuration

# Copyright (c) 2017 Clage GmbH
# SPDX-License-Identifier: Apache-2.0

if BOARD_KNOB_ARRAY

config SPI_STM32_INTERRUPT
	default y
	depends on SPI

endif # BOARD_STM32F072B_DISCO
```

## boards/helmutlord/knob_array/Kconfig.knob_array
```kconfig
# Copyright (c) 2017 Clage GmbH
# SPDX-License-Identifier: Apache-2.0

config BOARD_KNOB_ARRAY
	select SOC_STM32F072XB
```

## boards/xtensa/adafruit_feather_esp32s3/Kconfig.board
```kconfig
# Copyright (c) 2022 Espressif Systems (Shanghai) Co., Ltd.
# SPDX-License-Identifier: Apache-2.0

# ESP32S3 DevKitM board configuration
config BOARD_ADAFRUIT_FEATHER_ESP32S3
	bool "Adafruit ESP32-S3 Feather"
	depends on SOC_SERIES_ESP32S3

choice SOC_PART_NUMBER
	default SOC_ESP32S3_MINI_N4R2
endchoice
```

## drivers/adc/Kconfig.ads131m0x
```kconfig
config ADC_ADS131M0X
	bool "ADS131M0X driver"
	default y
	depends on DT_HAS_TI_ADS131M02_ENABLED || DT_HAS_TI_ADS131M03_ENABLED || \
		   DT_HAS_TI_ADS131M04_ENABLED || DT_HAS_TI_ADS131M06_ENABLED || \
		   DT_HAS_TI_ADS131M08_ENABLED

	select SPI
	select ADC_CONFIGURABLE_INPUTS
	help
	  Enable ADS131M0X ADC driver.

if ADC_ADS131M0X

config ADC_ADS131M0X_INIT_PRIORITY
	int "Init priority"
	default 80
	help
	  ADS1X1X ADC device driver initialization priority.

config ADC_ADS131M0X_ASYNC_THREAD_INIT_PRIORITY
	int "ADC ADS131M0X async thread priority"
	default 0

config ADC_ADS131M0X_ACQUISITION_THREAD_PRIORITY
	int "Priority for the ADC data acquisition thread"
	default 0
	help
	  Priority level for the internal ADC data acquisition thread.

config ADC_ADS131M0X_ACQUISITION_THREAD_STACK_SIZE
	int "Stack size for the ADC data acquisition thread"
	default 400
	help
	  Size of the stack used for the internal data acquisition
	  thread.

endif # ADC_ADS131M0X
```

## drivers/sensor/at42qt2120/Kconfig
```kconfig
# Copyright (c) 2023 Kelly Helmut Lord
# SPDX-License-Identifier: Apache-2.0

menuconfig AT42QT2120
	bool "AT42QT2120 Capacitance-to-Digital Converter"
	default y
	depends on DT_HAS_MICROCHIP_AT42QT2120_ENABLED
	select I2C
	help
	  Enable driver for AT42QT2120 capacative touch controller.

if AT42QT2120

endif # AT42QT2120
```

## drivers/sensor/ti/opt4001/Kconfig
```kconfig
# OPT4001 light sensor configuration options

# Copyright (c) 2024 Kelly Helmut Lord
# SPDX-License-Identifier: Apache-2.0

config OPT4001
	bool "OPT4001 Light Sensor"
	default y
	depends on DT_HAS_TI_OPT4001DTS_ENABLED || DT_HAS_TI_OPT4001YMN_ENABLED
	select I2C
	help
	  Enable driver for OPT4001 light sensors.
```

## drivers/sensor/ti/tmag5253/Kconfig
```kconfig
# Copyright (c) 2022 The ZMK Contributors
# SPDX-License-Identifier: MIT

config TMAG5253
    bool "TMAG5253 Hall-effect Sensor"
    default y
    depends on DT_HAS_TI_TMAG5253_ENABLED
    select ADC
    select GPIO
    help
      Enable driver for TMAG5253 Hall-effect sensor.
```

## drivers/usb/udc/Kconfig.rpi_pico
```kconfig
# Copyright (c) 2023 Nordic Semiconductor ASA
# SPDX-License-Identifier: Apache-2.0

config UDC_RPI_PICO
	bool "Raspberry Pi Pico USB device controller driver"
	default y
	depends on DT_HAS_ZEPHYR_UDC_RPI_PICO_ENABLED
	help
	  Skeleton for an USB device controller driver.

config UDC_RPI_PICO_STACK_SIZE
	int "UDC controller driver internal thread stack size"
	depends on UDC_RPI_PICO
	default 512
	help
	  Raspberry Pi Pico device controller driver internal thread stack size.

config UDC_RPI_PICO_THREAD_PRIORITY
	int "Raspberry Pi Pico controller driver thread priority"
	depends on UDC_RPI_PICO
	default 8
	help
	  Raspberry Pi Pico device controller driver thread priority.
```

## dts/bindings/adc/ti,ads131m08.yaml
```yaml
description: Texas Instrument ADS131M08 SPI ADC

compatible: "ti,ads131m08"

include: ti,ads131m0x-base.yaml
```

## dts/bindings/adc/ti,ads131m0x-base.yaml
```yaml
# Common fields for Texas Instruments ADS131M0X

include: [adc-controller.yaml, spi-device.yaml]

on-bus: spi

properties:
  drdy-gpios:
    type: phandle-array
    required: false
    description: |
      gpio for data ready, becomes active when a conversion result is ready
  reset-gpios:
    type: phandle-array
    required: false
    description: |
      gpio to reset adc
```

## dts/bindings/sensor/microchip,at42qt2120.yaml
```yaml
# Copyright (c) 2023 Kelly Helmut Lord
# SPDX-License-Identifier: Apache-2.0

description: Microchip AT42QT2120 12 channel touch sensor

compatible: "microchip,at42qt2120"

include: [sensor-device.yaml, i2c-device.yaml]

properties:
  change-gpios:
    type: phandle-array
    description: |
      Active low state change interrupt pin. Requires an
      external pull-up resistor.

  acquisition-time:
    type: int
    default: 1
    description: |
      Maximum 0xFF value in units of 16ms. Determines time
      between key acquisitions.

  toward-touch-drift:
    type: int
    default: 20
    description: |
      Maximum 0x8F value in units of 160ms. Determines
      drift compensation rate of object moving toward
      sensor.

  away-touch-drift:
    type: int
    default: 5
    description: |
      Maximum 0x8F value in units of 160ms. Determines
      drift compensation rate of object moving away from
      sensor.

  detection-integrator:
    type: int
    default: 4
    description: |
      Number of consecutive measurements required
      to confirm a key press.

  touch-recal-delay:
    type: int
    default: 255
    description: |
      Maximum 0xFF value in units of 160ms. Determines
      the length of time to recalibrate the touch pad
      in case an object remains in contact.

  drift-hold-time:
    type: int
    default: 25
    description:
      Maximum 0xFF value in units of 160ms. Determines time
      drift is halted after key detection.

  charge-time:
    type: int
    default: 0
    description: |
      Prolongs the charge-transfer period of
      acquisition by 1 us per count.
```

## dts/bindings/sensor/ti,opt4001dts.yaml
```yaml
# Copyright (c) 2024 Kelly Helmut Lord
# SPDX-License-Identifier: Apache-2.0

description: Texas Instruments OPT4001 ambient light sensor in SOT-5x3 package

compatible: "ti,opt4001dts"

include: [sensor-device.yaml, i2c-device.yaml]
```

## dts/bindings/sensor/ti,opt4001ymn.yaml
```yaml
# Copyright (c) 2024 Kelly Helmut Lord
# SPDX-License-Identifier: Apache-2.0

description: Texas Instruments OPT4001 ambient light sensor in PicoStar package

compatible: "ti,opt4001ymn"

include: [sensor-device.yaml, i2c-device.yaml]
```

## dts/bindings/sensor/ti,tmag5253.yaml
```yaml
# Copyright (c) 2024 Kelly Helmut Lord
# SPDX-License-Identifier: Apache-2.0

description: TMAG5253 Hall Effect Sensor

compatible: "ti,tmag5253"

include: [sensor-device.yaml]

properties:
  io-channels:
    required: true
    description: |
      ADC IO channel connected to the output of the TMAG5253 sensor.
  enable-gpios:
    type: phandle-array
    description: |
      Identifies sensor enable GPIOs. So long as the load capacitance
      drive limit of the TMAG5253 is observed, multiple outputs can
      share the same ADC input by enabling them one at a time.
  vdd:
    type: int
    description: |
      Supply voltage in millivolts (mV), used to determine mid-scale
  b-sensitivity:
    type: int
    enum:
     - 200
     - 400
     - 800
     - 1600
    description: |
      Sensitivity to magnetic flux density in gauss (G)
      TMAG5253A1 - 200 gauss
      TMAG5253A2 - 400 gauss
      TMAG5253A3 - 800 gauss
      TMAG5253A4 - 1600 gauss
  enable-timeout:
    type: int
    default: 20
    description: |
      Timeout between sensor enable and valid reading in microseconds (us)
```
